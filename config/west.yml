## config/west.yml
```yaml
manifest:
  remotes:
    - name: zmkfirmware
      url-base: https://github.com/zmkfirmware
    - name: scalaw4g
      url-base: https://github.com/scalaw4g
    - name: badjeff
      url-base: https://github.com/badjeff
    # Additional modules containing boards/shields/custom code can be listed here as well
    # See https://docs.zephyrproject.org/3.2.0/develop/west/manifest.html#projects
  projects:
    - name: zmk
      remote: zmkfirmware
      revision: main
      import: app/west.yml
    - name: zmk-tamago60
      remote: scalaw4g
      revision: main
    - name: zmk-hid-io
      remote: badjeff
      revision: main
    - name: zmk-analog-input-driver
      remote: badjeff
      revision: main
  self:
    path: config
```
